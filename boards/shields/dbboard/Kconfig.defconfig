## boards/shields/dbboard/Kconfig.defconfig
```kconfig
if SHIELD_DBBOARD_LEFT
  config ZMK_KEYBOARD_NAME
      default "DBBoard"

  config ZMK_SPLIT_ROLE_CENTRAL
      default y
endif


if SHIELD_DBBOARD_LEFT || SHIELD_DBBOARD_RIGHT
  config ZMK_SPLIT
      default y
endif

CONFIG_ZMK_BLE_EXPERIMENTAL_FEATURES=y
CONFIG_BT_CTLR_TX_PWR_PLUS_8=y
```

## boards/shields/dbboard/Kconfig.shield
```kconfig
config SHIELD_DBBOARD_LEFT
  def_bool $(shields_list_contains,dbboard_left)

config SHIELD_DBBOARD_RIGHT
  def_bool $(shields_list_contains,dbboard_right)
```
